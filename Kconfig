## Kconfig
```kconfig
config MONA2_INPUT_PROCESSOR_SPEED_ACCEL
    bool "Speed-dependent cursor scaling for the trackball"
    default y
    depends on DT_HAS_MONA2_INPUT_PROCESSOR_SPEED_ACCEL_ENABLED
    help
      Keyball-style pointer acceleration: the size of each movement
      (|x| + |y|) picks a multiplier from a table, so slow movements are
      slowed down for precise aiming and fast flicks are sped up.
      Built automatically when a "mona2,input-processor-speed-accel"
      node is enabled in the devicetree (right half only).
```

## dts/bindings/input_processors/mona2,input-processor-speed-accel.yaml
```yaml
description: |
  Keyball-style speed-dependent pointer scaling.

  movement = |x| + |y| of the current sensor report. The first entry of
  "thresholds" that movement is strictly greater than selects the matching
  entry of "multipliers-percent". If none matches, "default-percent" is used.
  Thresholds must be in descending order.

compatible: "mona2,input-processor-speed-accel"

include: ip_zero_param.yaml

properties:
  thresholds:
    type: array
    required: true
    description: Movement thresholds in sensor counts per report, descending.
  multipliers-percent:
    type: array
    required: true
    description: Multiplier for each threshold, in percent (150 = 1.5x).
  default-percent:
    type: int
    default: 100
    description: Multiplier used when movement is not above any threshold.
  pair-timeout-ms:
    type: int
    default: 30
    description: |
      X and Y arrive as separate events. When an X event comes, the Y of the
      previous report is used for |y| if it is newer than this.
```
